## config/west.yml
```yaml
manifest:
  remotes:
    - name: zmkfirmware
      url-base: https://github.com/zmkfirmware
    - name: gabecar3
      url-base: https://github.com/gabecar3
  projects:
    - name: zmk
      remote: gabecar3
      revision: sofle
      import: app/west.yml
  self:
    path: config
```
